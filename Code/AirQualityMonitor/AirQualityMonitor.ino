// ESP8266 Libraries
#include <ESP8266WiFi.h>
#include <ArduinoOTA.h>
#include <ESP8266mDNS.h>
#include <ESPAsyncWebServer.h>
#include <AsyncWebSocket.h>
#include <LittleFS.h>
#include <ThingSpeak.h>
#include <ArduinoJson.h>

#include <Adafruit_SSD1306.h> // SSD1306 Screen Library
#include <DHT.h> // DHT11 Library
#include <MQUnifiedsensor.h> // MQxxx Library
#include "secrets.h" // Wi-Fi Credentials

// Definitions for DHT11
#define DHTTYPE DHT11
#define DHT_PIN D5

// Definitions for MQ135
#define BOARD "ESP8266"
#define GAS_SENSOR_PIN A0
#define GAS_SENSOR_TYPE "MQ-135"
#define ADC_RESOLUTION 10
#define VG_RESOLUTION 3.3

// Definitions for OLED Display
#define DISPLAY_I2C_ADDRESS 0x3C

// Definitions for HTTP Server
#define HTTP_SERVER_PORT 80

#define INTERVAL 300000UL

AsyncWebServer server(HTTP_SERVER_PORT);
AsyncWebSocket ws("/ws");
WiFiClient client;

DHT dht(DHT_PIN, DHTTYPE);
MQUnifiedsensor MQ135(BOARD, VG_RESOLUTION, ADC_RESOLUTION, GAS_SENSOR_PIN, GAS_SENSOR_TYPE);
Adafruit_SSD1306 oled(128, 64, &Wire);

unsigned long currentMillis, previousMillis = 0;

const unsigned char PROGMEM logo[512] = {
    0x00, 0x00, 0x00, 0x00, 0x00, 0x00, 0x00, 0x00,
    0x00, 0x00, 0x00, 0x00, 0x00, 0x00, 0x00, 0x00,
    0x00, 0x00, 0x00, 0x00, 0x00, 0x00, 0x00, 0x00,
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    0x00, 0x00, 0x00, 0x00, 0x00, 0x00, 0x00, 0x00
};

void InitOTA()
{
    ArduinoOTA.setHostname(myHostname);

    ArduinoOTA.onStart([]() {
        String type;

        if (ArduinoOTA.getCommand() == U_FLASH) {
            type = "sketch";
        }
        else {
            type = "filesystem";
            LittleFS.end();
        }

        Serial.println("Start updating " + type);
    });

    ArduinoOTA.onEnd([]() {
        Serial.println("\nEnd");
    });

    ArduinoOTA.onProgress([](unsigned int progress, unsigned int total) {
        Serial.printf("Progress: %u%%\r", (progress / (total / 100)));
    });

    ArduinoOTA.onError([](ota_error_t error) {
        Serial.printf("Error[%u]: ", error);
        if (error == OTA_AUTH_ERROR) {
            Serial.println("Auth Failed");
        } else if (error == OTA_BEGIN_ERROR) {
            Serial.println("Begin Failed");
        } else if (error == OTA_CONNECT_ERROR) {
            Serial.println("Connect Failed");
        } else if (error == OTA_RECEIVE_ERROR) {
            Serial.println("Receive Failed");
        } else if (error == OTA_END_ERROR) {
            Serial.println("End Failed");
        }
    });

    ArduinoOTA.begin();
    MDNS.addService("http", "tcp", HTTP_SERVER_PORT);
}

void writeText(String text, byte size, byte column, byte row)
{
    oled.setTextColor(SSD1306_WHITE);
    oled.setTextSize(size); // 1 = 6x8 | 2 = 12x16 | 3 = 24x32
    oled.setCursor(column, row);
    oled.print(text);
    oled.display();
}

void showBootScreen()
{
    oled.clearDisplay();
    oled.drawBitmap(32, 0, logo, 64, 64, SSD1306_WHITE);
    oled.display();
    delay(1500);
}

void showConnInfo(String ssid, String ip, String hostname)
{
    oled.clearDisplay();
    writeText("SSID: " + ssid, 1, 0, 0);
    writeText("IP: " + ip, 1, 0, 24);
    writeText(hostname + ".local", 1, 0, 40);
    delay(3000);
}

void showDataTemplate()
{
    oled.clearDisplay();
    writeText("Calidad de aire:", 1, 0, 0);
    writeText("Temperatura:", 1, 0, 24);
    writeText("Humedad:", 1, 0, 48);
}

void connectWiFi(bool useStaticIP = false)
{
    WiFi.mode(WIFI_STA);
    WiFi.begin(ssid, password);

    if(useStaticIP)
        WiFi.config(ip, gateway, subnet);

    while (WiFi.status() != WL_CONNECTED)
        delay(200);

    showConnInfo(ssid, WiFi.localIP().toString(), myHostname);
}

void onWsEvent(AsyncWebSocket * server, AsyncWebSocketClient * client, AwsEventType type, void * arg, uint8_t *data, size_t len)
{
    switch(type)
    {
        case WS_EVT_CONNECT:
            break;
        case WS_EVT_DISCONNECT:
            break;
        case WS_EVT_ERROR:
            break;
        case WS_EVT_PONG:
            break;
        case WS_EVT_DATA:
            break;
        default:
            break;
    }
}

void calibrateGasSensor()
{
    float calcR0 = 0;

    for (int i = 0; i < 10; i++)
    {
        MQ135.update();
        calcR0 += MQ135.calibrate(3.6);
    }

    MQ135.setR0(calcR0 / 10);

    if (isinf(calcR0))
        while (1);

    if (calcR0 == 0)
        while (1);
}

void gasSensorInit()
{
    MQ135.setRegressionMethod(1); // _PPM =  a*ratio^b
    MQ135.setA(605.18); MQ135.setB(-3.937); // Configure the equation to calculate CO concentration
    MQ135.init();
    calibrateGasSensor();
}

void checkSensors()
{
    String output;
    float currentGasLevel, temperature, humidity;
    DynamicJsonDocument doc(1024);

    MQ135.update();
    currentGasLevel = MQ135.readSensor();

    temperature = dht.readTemperature();
    humidity = dht.readHumidity();

    // update display
    oled.fillRect(0, 8, 128, 16, BLACK);
    writeText(String(currentGasLevel, 2), 2, 46, 8);

    doc["air"] = currentGasLevel;
    ThingSpeak.setField(1, currentGasLevel);

    if (!(isnan(temperature) || isnan(humidity)))
    {
        // update display
        oled.fillRect(0, 32, 128, 16, BLACK);
        writeText(String(temperature, 2), 2, 34, 32);
        oled.fillRect(0, 56, 128, 8, BLACK);
        writeText(String(humidity, 2), 1, 49, 56);

        doc["temperature"] = temperature;
        doc["humidity"] = humidity;
        ThingSpeak.setField(2, temperature);
        ThingSpeak.setField(3, humidity);
    }

    // update web
    serializeJson(doc, output);
    ws.textAll(output);

    // update ThingSpeak
    oled.fillRect(120, 0, 8, 8, BLACK);
    if (ThingSpeak.writeFields(channelNumber, apiKey) != TS_OK_SUCCESS)
        writeText("^", 1, 120, 0);
}

void initServer()
{
    server.serveStatic("/", LittleFS, "/").setDefaultFile("index.html");

    server.onNotFound([](AsyncWebServerRequest *request) {
        request->send(400, "text/plain", "Not found");
    });

    server.begin();
}

void initWebSockets()
{
    ws.onEvent(onWsEvent);
    server.addHandler(&ws);
}

void setup(void)
{
    Serial.begin(115200);
    LittleFS.begin();
    oled.begin(SSD1306_SWITCHCAPVCC, DISPLAY_I2C_ADDRESS);

    showBootScreen();
    connectWiFi();
    InitOTA();
    initWebSockets();
    initServer();
    ThingSpeak.begin(client);

    dht.begin();
    gasSensorInit();

    showDataTemplate();

    checkSensors();
}

void loop(void)
{
    currentMillis = millis();

    if (currentMillis - previousMillis >= INTERVAL)
    {
        previousMillis = currentMillis;
        checkSensors();
    }

    ArduinoOTA.handle();
}
